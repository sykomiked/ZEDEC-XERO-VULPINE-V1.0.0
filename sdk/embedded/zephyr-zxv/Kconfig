## sdk/embedded/zephyr-zxv/Kconfig
```kconfig
# Copyright (c) 2024-2026 Michael Laurence Curzi and 36N9 Genetics, LLC
# SPDX-License-Identifier: Apache-2.0

menuconfig ZXV
	bool "ZXV: exact rationals, four-valued logic, budgets and ledger (libzxv subset)"
	help
	  Builds the microcontroller subset of libzxv (sdk/libzxv) with the
	  ZXV port layer (sdk/embedded/port) and the zxe helpers (fixed-memory
	  ledger, phase-clock driver). ADVISORY ONLY for anything that actuates:
	  see sdk/embedded/README.md, "Safety".

if ZXV

config ZXV_HEAP_SIZE
	int "Bytes in the dedicated ZXV heap"
	default 98304
	help
	  Every libzxv allocation comes from one k_heap of this size. A
	  context, a capability, one rmag and one phase clock need about
	  60 KB on a 32-bit core (sdk/embedded/README.md, "RAM"). An
	  allocation that does not fit fails with ZXV_E_NOMEM; it never
	  takes memory from the system heap.

choice ZXV_ENTROPY
	prompt "Entropy source for ZXV"
	default ZXV_ENTROPY_NONE
	help
	  ZXV refuses to open a context until an entropy source passed its
	  start-up test (fail closed). Choosing the source is the
	  integrator's responsibility.

config ZXV_ENTROPY_NONE
	bool "None: the application calls zxp_set_entropy() and zxp_init()"
	help
	  Nothing is installed at boot. Until the application installs its
	  board's TRNG with zxp_set_entropy() and calls zxp_init(), every
	  zxv_ctx_create() fails.

config ZXV_ENTROPY_CSPRNG
	bool "sys_csrand_get() backed by a hardware entropy driver"
	depends on ENTROPY_GENERATOR && CSPRNG_ENABLED && !TEST_CSPRNG_GENERATOR
	help
	  Uses Zephyr's cryptographically secure generator, which needs a real
	  entropy driver behind the devicetree's zephyr,entropy node
	  (CONFIG_ENTROPY_GENERATOR=y). Not
	  offered when Zephyr would fall back to its insecure test CSPRNG.

config ZXV_ENTROPY_INSECURE_TEST
	bool "INSECURE test generator (emulators and CI only)"
	depends on TEST_RANDOM_GENERATOR
	help
	  sys_rand_get(), which with TEST_RANDOM_GENERATOR is not random. For
	  QEMU and native_sim runs only. Prints a warning at boot. Never ship
	  a build with this option.

endchoice

config ZXV_AUTO_INIT
	bool "Install the chosen entropy source and run zxp_init() at boot"
	default y
	help
	  At APPLICATION init level. If it fails (no source, or the source
	  failed its health test) the system keeps booting and ZXV stays
	  closed: zxv_ctx_create() returns ZXV_E_INTERNAL.

config ZXV_PQC
	bool "ML-KEM-1024, ML-DSA-87 and Ed25519"
	help
	  Adds the post-quantum and Ed25519 code (gateways; flash cost in
	  sdk/embedded/README.md). Off by default.

endif # ZXV
```
